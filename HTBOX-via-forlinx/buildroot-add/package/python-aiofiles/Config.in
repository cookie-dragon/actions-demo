## HTBOX-via-forlinx/buildroot-add/package/python-aiofiles/Config.in
```kconfig
config BR2_PACKAGE_PYTHON_AIOFILES
	bool "python-aiofiles"
	help
	  File support for asyncio.

	  https://github.com/Tinche/aiofiles
```

## HTBOX-via-forlinx/buildroot-add/package/python-asyncua/Config.in
```kconfig
config BR2_PACKAGE_PYTHON_ASYNCUA
	bool "python-asyncua"
	select BR2_PACKAGE_PYTHON_AIOFILES # runtime
	select BR2_PACKAGE_PYTHON_AIOSQLITE # runtime
	select BR2_PACKAGE_PYTHON_DATEUTIL # runtime
	select BR2_PACKAGE_PYTHON_PYTZ # runtime
	select BR2_PACKAGE_PYTHON_CRYPTOGRAPHY # runtime
	select BR2_PACKAGE_PYTHON_SORTEDCONTAINERS # runtime
	help
	  Pure Python OPC-UA client and server library.

	  http://freeopcua.github.io/
```

## HTBOX-via-forlinx/buildroot-add/package/python-pyotp/Config.in
```kconfig
config BR2_PACKAGE_PYTHON_PYOTP
	bool "python-pyotp"
	help
	  Python One Time Password Library.

	  https://github.com/pyotp/pyotp
```

## htbox-forlinx/buildroot-add/package/python-htbox/Config.in
```kconfig
config BR2_PACKAGE_PYTHON_HTBOX
	depends on BR2_PACKAGE_PYTHON3
	select BR2_PACKAGE_PYTHON_IPY
	bool "python-htbox"
```
